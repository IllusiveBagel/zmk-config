## boards/shields/plebsplit/Kconfig.defconfig
```kconfig
if SHIELD_PLEBSPLIT_LEFT

config ZMK_PLEBSPLIT
    default "plebsplit"

config ZMK_SPLIT_ROLE_CENTRAL
    default y

endif

if SHIELD_PLEBSPLIT_LEFT || SHIELD_PLEBSPLIT_RIGHT

config ZMK_SPLIT
    default y

endif
```

## boards/shields/plebsplit/Kconfig.shield
```kconfig
config SHIELD_PLEBSPLIT_LEFT
    def_bool $(shields_list_contains,plebsplit_left)

config SHIELD_PLEBSPLIT_RIGHT
    def_bool $(shields_list_contains,plebsplit_right)
```

## boards/shields/splitOrtho/Kconfig.defconfig
```kconfig
if SHIELD_SPLITORTHO_LEFT

config ZMK_SPLITORTHO
    default "SplitOrtho"

config ZMK_SPLIT_ROLE_CENTRAL
    default y

endif

if SHIELD_SPLITORTHO_LEFT || SHIELD_SPLITORTHO_RIGHT

config ZMK_SPLIT
    default y

endif
```

## boards/shields/splitOrtho/Kconfig.shield
```kconfig
config SHIELD_SPLITORTHO_LEFT
    def_bool $(shields_list_contains,splitOrtho_left)

config SHIELD_SPLITORTHO_RIGHT
    def_bool $(shields_list_contains,splitOrtho_right)
```

## boards/shields/test/Kconfig.defconfig
```kconfig
if SHIELD_TEST

# Name must be less than 16 characters long!
config ZMK_TEST
    default "Test"

endif
```
